## conf/layer.conf
```bitbake
# We have a conf and classes directory, append to BBPATH
BBPATH .= ":${LAYERDIR}"

BBFILES += " \
    ${LAYERDIR}/recipes*/*/*.bb \
    ${LAYERDIR}/recipes*/*/*.bbappend \
    ${LAYERDIR}/recipes*/*/*/*.bb \
    ${LAYERDIR}/recipes*/*/*/*.bbappend \
    ${LAYERDIR}/images/*.bb \
"

BBFILE_COLLECTIONS += "amarula-demo-layer"
BBFILE_PATTERN_amarula-demo-layer := "^${LAYERDIR}/"
BBFILE_PRIORITY_amarula-demo-layer = "15"

LAYERDEPENDS_amarula-demo-layer = "core openembedded-layer"
LAYERRECOMMENDS_amarula-demo-layer = " flutter-layer"
LAYERSERIES_COMPAT_amarula-demo-layer = "scarthgap"
```
